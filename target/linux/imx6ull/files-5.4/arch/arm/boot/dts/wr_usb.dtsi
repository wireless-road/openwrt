
&usbotg1 {
	dr_mode = "host";
	srp-disable;
	hnp-disable;
	adp-disable;
	disable-over-current;
	external-vbus-divider;
	phys = <&usbphy1>;
	phy-names = "usb-phy";
};

&usbotg2 {
	dr_mode = "host";
	disable-over-current;
	external-vbus-divider;
	phys = <&usbphy2>;
	phy-names = "usb-phy";
};
